## overlays/apps/examples/encfs_test/Kconfig
```kconfig
# SPDX-License-Identifier: Apache-2.0
config EXAMPLES_ENCFS_TEST
	bool "encfs_test: encrypted data volume acceptance tests"
	default n
	depends on ENCFSMGR && ENCFS_TESTING
	depends on BUILD_FLAT
	help
	  Exercise encrypted paths, lifecycle, persistence and failure recovery.
```

## overlays/apps/system/encfs/Kconfig
```kconfig
# SPDX-License-Identifier: Apache-2.0
config SYSTEM_ENCFS
	bool "encfs: encrypted data volume control"
	default n
	depends on ENCFSMGR
	depends on BUILD_FLAT
	help
	  Control the encrypted data volume. Provision requires --erase.
	  With ENCFS_TESTING, testkey accepts a 32-byte hexadecimal test key,
	  restores the board key, or simulates a missing key provider. These
	  test commands require the volume to be stopped with no resources.
	  With ENCFS_KEYWRAP, rekey rotates the provider master identifier on
	  a mounted wrapped volume without replacing live data cipher keys.
	  Legacy directly-derived volumes reject rekey. With ENCFS_TESTING,
	  keyfiles selects the independent host-file simulator provider.
```

## overlays/apps/testing/fs/encfs_extended/Kconfig
```kconfig
config TESTING_ENCFS_EXTENDED
	bool "EncFS interrupted-write recovery fixture and Vela FS regression"
	default n
	depends on ENCFSMGR
	---help---
		Enable deterministic prepare/verify/churn commands on a dedicated
		EncFS test volume. The host may deliberately kill its emulator while
		churn runs; this simulates a process interruption, not hardware power loss.
		Also build the bounded Vela append/read loop from tests/testcases.
```

## validation/encfs-extension-20261025/source/manifests/overlays/apps/examples/encfs_test/Kconfig
```kconfig
# SPDX-License-Identifier: Apache-2.0
config EXAMPLES_ENCFS_TEST
	bool "encfs_test: encrypted data volume acceptance tests"
	default n
	depends on ENCFSMGR && ENCFS_TESTING
	depends on BUILD_FLAT
	depends on !DISABLE_PTHREAD
	help
	  Exercise encrypted paths, lifecycle, persistence and failure recovery.
	  The stress mode runs two concurrent file workloads for a requested
	  number of seconds (60 through 86400), with deterministic data checks.
```
